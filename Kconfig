## Kconfig
```kconfig
# SPDX-FileCopyrightText: <text>Copyright 2023-2024 Arm Limited and/or its
# affiliates <open-source-office@arm.com></text>
#
# SPDX-License-Identifier: MIT

mainmenu "Arm Automotive Solutions Build Config"

#############################
# User-facing configuration #
#############################
comment "End-User License Agreement"

config ARM_FVP_EULA_ACCEPT_CHOICE
    bool "Accept the END USER LICENSE AGREEMENT FOR ARM SOFTWARE DEVELOPMENT TOOLS"
    default n
    help
      Please refer to "https://developer.arm.com/downloads/-/arm-ecosystem-fvps/eula"

comment "Target Build Setup"

choice
    prompt "Use-Case"
    default EXTRA_IMAGE_FEATURES_ACTUATION

config EXTRA_IMAGE_FEATURES_CAM
    bool "Critical Application Monitoring Demo"

config EXTRA_IMAGE_FEATURES_ACTUATION
    bool "Safety Island Actuation Demo"

config EXTRA_IMAGE_FEATURES_HIPC
    bool "Safety Island Communication Demo (using HIPC)"

config EXTRA_IMAGE_FEATURES_SI_PSA_STORAGE_TESTS
    bool "Safety Island PSA Secure Storage APIs Architecture Test Suite"

config EXTRA_IMAGE_FEATURES_SI_PSA_CRYPTO_TESTS
    bool "Safety Island PSA Crypto APIs Architecture Test Suite"

comment "Arm SystemReady IR Validation"

config USE_CASE_IR_FIRMWARE
    bool "Arm SystemReady IR Firmware Build"

config USE_CASE_IR_ACS
    bool "Arm SystemReady IR Architecture Compliance Suite (ACS) Tests"

comment "Linux Distribution Installation (Debian, openSUSE and Fedora)"

config USE_CASE_LINUX_DISTRO_DEBIAN
    bool "Debian Linux Distro Installation"

config USE_CASE_LINUX_DISTRO_OPENSUSE
    bool "openSUSE Linux Distro Installation"

config USE_CASE_LINUX_DISTRO_FEDORA
    bool "Fedora Linux Distro Installation"

endchoice

choice
    depends on EXTRA_IMAGE_FEATURES_CAM || EXTRA_IMAGE_FEATURES_ACTUATION || EXTRA_IMAGE_FEATURES_HIPC || EXTRA_IMAGE_FEATURES_SI_PSA_STORAGE_TESTS || EXTRA_IMAGE_FEATURES_SI_PSA_CRYPTO_TESTS
    prompt "Reference Software Stack Architecture"
    default ARCHITECTURE_BAREMETAL

config ARCHITECTURE_BAREMETAL
    bool "Baremetal"

config ARCHITECTURE_VIRTUALIZATION
    depends on EXTRA_IMAGE_FEATURES_ACTUATION || EXTRA_IMAGE_FEATURES_HIPC || EXTRA_IMAGE_FEATURES_CAM
    bool "Virtualization"

endchoice

comment "Runtime Validation Setup"
    depends on EXTRA_IMAGE_FEATURES_CAM || EXTRA_IMAGE_FEATURES_ACTUATION || EXTRA_IMAGE_FEATURES_HIPC || EXTRA_IMAGE_FEATURES_SI_PSA_STORAGE_TESTS || EXTRA_IMAGE_FEATURES_SI_PSA_CRYPTO_TESTS

config RUN_TESTS
    depends on EXTRA_IMAGE_FEATURES_CAM || EXTRA_IMAGE_FEATURES_ACTUATION || EXTRA_IMAGE_FEATURES_HIPC || EXTRA_IMAGE_FEATURES_SI_PSA_STORAGE_TESTS || EXTRA_IMAGE_FEATURES_SI_PSA_CRYPTO_TESTS
    bool "Run Automated Validation"
    default n

##############
# Set up Kas #
##############

config KAS_INCLUDE_ARCHITECTURE
    string
    default "yocto/kas/virtualization.yml" if ARCHITECTURE_VIRTUALIZATION
    default "yocto/kas/baremetal.yml" if ARCHITECTURE_BAREMETAL
    default "yocto/kas/arm-systemready-firmware.yml" if USE_CASE_IR_FIRMWARE
    default "yocto/kas/arm-systemready-ir-acs.yml" if USE_CASE_IR_ACS
    default "yocto/kas/arm-systemready-linux-distros-debian.yml" if USE_CASE_LINUX_DISTRO_DEBIAN
    default "yocto/kas/arm-systemready-linux-distros-opensuse.yml" if USE_CASE_LINUX_DISTRO_OPENSUSE
    default "yocto/kas/arm-systemready-linux-distros-fedora.yml" if USE_CASE_LINUX_DISTRO_FEDORA

config KAS_INCLUDE_APPLICATION
    string
    default "yocto/kas/cam.yml" if EXTRA_IMAGE_FEATURES_CAM
    default "yocto/kas/hipc-validation.yml" if EXTRA_IMAGE_FEATURES_HIPC
    default "yocto/kas/si-psa-storage-tests.yml" if EXTRA_IMAGE_FEATURES_SI_PSA_STORAGE_TESTS
    default "yocto/kas/si-psa-crypto-tests.yml" if EXTRA_IMAGE_FEATURES_SI_PSA_CRYPTO_TESTS

if RUN_TESTS
    config TESTIMAGE_AUTO
        string
        default "1" if RUN_TESTS
endif

config ARM_FVP_EULA_ACCEPT
    string
    default "1" if ARM_FVP_EULA_ACCEPT_CHOICE
    default "0"
```

## components/safety_island/zephyr/src/Kconfig
```kconfig
#
# SPDX-FileCopyrightText: <text>Copyright 2023 Arm Limited and/or its
# affiliates <open-source-office@arm.com></text>
#
# SPDX-License-Identifier: Apache-2.0

rsource "drivers/Kconfig"
```

## components/safety_island/zephyr/src/apps/actuation/boards/fvp_rd_kronos_safety_island_c0_actuation.conf
```kconfig
#
# SPDX-FileCopyrightText: <text>Copyright 2023 Arm Limited and/or its
# affiliates <open-source-office@arm.com></text>
#
# SPDX-License-Identifier: Apache-2.0

CONFIG_NET_CONFIG_SETTINGS=n

CONFIG_NET_IFACE1_ADDR="192.168.10.0"
CONFIG_NET_IFACE1_GW="192.168.10.254"
CONFIG_NET_IFACE1_NETMASK="255.255.255.0"

CONFIG_NET_IFACE2_ADDR="192.168.0.1"
CONFIG_NET_IFACE2_NETMASK="255.255.255.0"
CONFIG_NET_IFACE2_VLAN=100

CONFIG_NET_IF_MAX_IPV4_COUNT=2

CONFIG_MDIO=y
CONFIG_MDIO_SHELL=n
CONFIG_MDIO_INIT_PRIORITY=82
CONFIG_PHY_INIT_PRIORITY=83

CONFIG_DDS_NETWORK_INTERFACE="veth_rpmsg"

CONFIG_IPC_RPMSG_VETH=n
```

## components/safety_island/zephyr/src/apps/actuation/boards/fvp_rd_kronos_safety_island_c2_actuation.conf
```kconfig
#
# SPDX-FileCopyrightText: <text>Copyright 2023 Arm Limited and/or its
# affiliates <open-source-office@arm.com></text>
#
# SPDX-License-Identifier: Apache-2.0

CONFIG_NET_CONFIG_SETTINGS=n

CONFIG_IPC_RPMSG_VETH_SI_IPV4_ADDR_0=""
CONFIG_IPC_RPMSG_VETH_SI_NETMASK_0=""

CONFIG_NET_IFACE1_ADDR="192.168.2.1"
CONFIG_NET_IFACE1_NETMASK="255.255.255.0"
CONFIG_NET_IFACE1_VLAN=300

CONFIG_NET_IFACE2_ADDR="192.168.10.2"
CONFIG_NET_IFACE2_GW="192.168.10.254"
CONFIG_NET_IFACE2_NETMASK="255.255.255.0"

CONFIG_DDS_NETWORK_INTERFACE="veth_rpmsg"

CONFIG_SYSTEM_WORKQUEUE_STACK_SIZE=8196
CONFIG_IPC_SERVICE_BACKEND_RPMSG_WQ_STACK_SIZE=8196

# Work around a bug appearing when multiple cores are used
CONFIG_SCHED_CPU_MASK_PIN_ONLY=y
```

## components/safety_island/zephyr/src/apps/cam/boards/fvp_rd_kronos_safety_island_c1_cam.conf
```kconfig
#
# SPDX-FileCopyrightText: <text>Copyright 2023 Arm Limited and/or its
# affiliates <open-source-office@arm.com></text>
#
# SPDX-License-Identifier: Apache-2.0

# Disable the IPC service
CONFIG_IPC_SERVICE=n
CONFIG_IPC_RPMSG_VETH=n

# Enable networking
CONFIG_CAM_SERVICE_IP="192.168.1.1"
CONFIG_NET_L2_ETHERNET=y
CONFIG_NET_CONFIG_SETTINGS=y
CONFIG_NET_MAX_CONTEXTS=10
CONFIG_NET_MAX_CONN=10

# Log config
CONFIG_CAM_LOG_LEVEL=3
CONFIG_FS_LOG_LEVEL_OFF=y

# FS config
CONFIG_FS_FATFS_REENTRANT=y
```

## components/safety_island/zephyr/src/apps/psa-storage-tests/boards/fvp_rd_kronos_safety_island_c2.conf
```kconfig
# SPDX-FileCopyrightText: <text>Copyright 2023 Arm Limited and/or its
# affiliates <open-source-office@arm.com></text>
#
# SPDX-License-Identifier: Apache-2.0

CONFIG_TFM_PSA_PROTECTED_STORAGE_API=y
CONFIG_TFM_PSA_INTERNAL_TRUSTED_STORAGE_API=y
CONFIG_PSA_ARCH_TEST_STORAGE=y
CONFIG_PSA_ARCH_TEST_API_TFM_HEADERS=y
```

## components/safety_island/zephyr/src/boards/arm64/fvp_rd_kronos_cortex_r82/Kconfig.board
```kconfig
# SPDX-FileCopyrightText: <text>Copyright 2023 Arm Limited and/or its
# affiliates <open-source-office@arm.com></text>
#
# SPDX-License-Identifier: Apache-2.0

config BOARD_FVP_RD_KRONOS_CORTEX_R82
	bool "CORTEX_R82 clusters of FVP RD-Kronos simulation board"
	depends on SOC_FVP_AEMV8R_AARCH64
```

## components/safety_island/zephyr/src/boards/arm64/fvp_rd_kronos_cortex_r82/Kconfig.defconfig
```kconfig
# SPDX-FileCopyrightText: <text>Copyright 2023 Arm Limited and/or its
# affiliates <open-source-office@arm.com></text>
#
# SPDX-License-Identifier: Apache-2.0

if BOARD_FVP_RD_KRONOS_CORTEX_R82

config BUILD_OUTPUT_BIN
	default y

config BOARD
	default "fvp_rd_kronos_cortex_r82"

config NUM_IRQS
	default 256

endif # BOARD_FVP_RD_KRONOS_CORTEX_R82
```

## components/safety_island/zephyr/src/boards/arm64/fvp_rd_kronos_cortex_r82/fvp_rd_kronos_cortex_r82_c0_defconfig
```kconfig
# SPDX-FileCopyrightText: <text>Copyright 2023 Arm Limited and/or its
# affiliates <open-source-office@arm.com></text>
#
# SPDX-License-Identifier: Apache-2.0

CONFIG_SOC_SERIES_FVP_AEMV8R=y
CONFIG_SOC_FVP_AEMV8R_AARCH64=y
CONFIG_BOARD_FVP_RD_KRONOS_CORTEX_R82=y

# Image format
CONFIG_AARCH64_IMAGE_HEADER=y

# Cache management
CONFIG_CACHE_MANAGEMENT=y

CONFIG_THREAD_STACK_INFO=y

# Enable Timer and Sys clock
CONFIG_SYS_CLOCK_TICKS_PER_SEC=100
CONFIG_ARM_ARCH_TIMER=y

# Enable UART driver
CONFIG_SERIAL=y

# Enable serial port
CONFIG_UART_PL011=y

# Enable console
CONFIG_CONSOLE=y
CONFIG_UART_CONSOLE=y
```

## components/safety_island/zephyr/src/boards/arm64/fvp_rd_kronos_safety_island/Kconfig.board
```kconfig
# SPDX-FileCopyrightText: <text>Copyright 2023 Arm Limited and/or its
# affiliates <open-source-office@arm.com></text>
#
# SPDX-License-Identifier: Apache-2.0

config BOARD_FVP_RD_KRONOS_SAFETY_ISLAND
	bool "Safety Island clusters of FVP RD-Kronos simulation board"
	depends on SOC_FVP_AEMV8R_AARCH64
```

## components/safety_island/zephyr/src/drivers/Kconfig
```kconfig
#
# SPDX-FileCopyrightText: <text>Copyright 2023 Arm Limited and/or its
# affiliates <open-source-office@arm.com></text>
#
# SPDX-License-Identifier: Apache-2.0

menu "Drivers"
rsource "ethernet/Kconfig.smsc91x"
rsource "ethernet/Kconfig.veth_rpmsg"
rsource "ethernet/Kconfig.ipc_rpmsg_veth"
rsource "mbox/Kconfig"
endmenu
```

## components/safety_island/zephyr/src/drivers/ethernet/Kconfig.ipc_rpmsg_veth
```kconfig
#
# SPDX-FileCopyrightText: <text>Copyright 2023 Arm Limited and/or its
# affiliates <open-source-office@arm.com></text>
#
# SPDX-License-Identifier: Apache-2.0

# Virtual Ethernet over IPC RPMSG Static Vrings configuration options

menuconfig IPC_RPMSG_VETH
	bool "Virtual ethernet over IPC RPMSG Static Vrings"
	default n

config IPC_RPMSG_VETH_COUNT
	int "Number of virtual ethernet created"
	default 1
	help
	  By default only one network interface is created. It is possible
	  to create multiple interfaces in certain use cases.

config IPC_RPMSG_VETH_DRV_NAME
	string "IPC RPMSG Virtual Ethernet Driver Name"
	default "ipc_rpmsg_veth"
	help
	  This option sets the driver name and name of the network interface
	  in your host system. If there are multiple network interfaces defined,
	  then this value is used as a prefix and the interface names will be
	  ipc_rpmsg_veth0, ipc_rpmsg_veth1, etc.

config IPC_RPMSG_VETH_EPT_NAME_0
	string "RPMSG Named Service Announcement Endpoint name"
	help
	  RPMSG Named Service Announcement Endpoint name for virtual ethernet 0.

config IPC_RPMSG_VETH_MAC_ADDR_0
	string "Mac address"
	help
	  Ethernet mac address for virtual ethernet 0.

config IPC_RPMSG_VETH_SI_IPV4_ADDR_0
	string "IPv4 address"
	help
	  IPv4 address for virtual ethernet 0.

config IPC_RPMSG_VETH_SI_NETMASK_0
	string "Netmask"
	help
	  Static netmask to use if not overridden by DHCP for virtual
	  ethernet 0.
```

## components/safety_island/zephyr/src/drivers/ethernet/Kconfig.veth_rpmsg
```kconfig
#
# SPDX-FileCopyrightText: <text>Copyright 2023 Arm Limited and/or its
# affiliates <open-source-office@arm.com></text>
#
# SPDX-License-Identifier: Apache-2.0

# Virtual ethernet over rpmsg configuration options

menuconfig VETH_RPMSG
	bool "veth over rpmsg endpoint"
	default n

config VETH_MAC_ADDR
string "MAC address for the interface"
	help
	  Specify a MAC address for the Veth interface in the form of
	  six hex 8-bit chars separated by colons (e.g.:
	  11:22:33:44:55:66).  The default is an empty string, which
	  means the code will make 00:00:00:00:00:01.

config VETH_NS_NAME
string "Name advertised through nameservice"
	default "rpmsg-netdev"
	help
	  Specify a name, advertised through the nameservice, that uniquely
	  identifies this endpoint.
```

## components/safety_island/zephyr/src/drivers/fault_mgmt/Kconfig
```kconfig
#
# SPDX-FileCopyrightText: <text>Copyright 2023 Arm Limited and/or its
# affiliates <open-source-office@arm.com></text>
#
# SPDX-License-Identifier: Apache-2.0

config FAULT_MGMT_ARM_FMU
	bool "Arm Fault Management Unit"
	default n

config FAULT_MGMT_MAX_TREE_DEPTH
	int "Arm Fault Management maximum tree depth"
	default 4
	help
	  The maximum fault management device tree depth, used to statically
	  allocate memory for tree traversal.
```

## components/safety_island/zephyr/src/drivers/ipm/Kconfig
```kconfig
#
# SPDX-FileCopyrightText: <text>Copyright 2023 Arm Limited and/or its
# affiliates <open-source-office@arm.com></text>
#
# SPDX-License-Identifier: Apache-2.0

if IPM

config IPM_MHUV3
	bool "ARM MHUV3 IPM driver"
	help
	  Driver for arm MHUv3 (Message Handling Unit v3)

config IPM_MHUV3_MAX_LOGICAL_CH_NUM
	int "The maximum number of MHUv3's logical channel"
	default 32
	depends on IPM_MHUV3
	help
	  This option specifies the maximum number of logical
	  channels. The default value is 32.

endif #IPM
```

## components/safety_island/zephyr/src/drivers/mbox/Kconfig
```kconfig
#
# SPDX-FileCopyrightText: <text>Copyright 2023 Arm Limited and/or its
# affiliates <open-source-office@arm.com></text>
#
# SPDX-License-Identifier: Apache-2.0

if MBOX

config MBOX_MHUV3
	bool "ARM MHUV3 MBOX driver"
	help
	  Driver for Arm MHUv3 (Message Handling Unit v3)

config MBOX_MHUV3_MAX_LOGICAL_CH_NUM
	int "The maximum number of MHUv3's logical channel"
	default 32
	depends on MBOX_MHUV3
	help
	  This option specifies the maximum number of logical
	  channels. The default value is 32.

endif #MBOX
```

## components/safety_island/zephyr/src/dts/bindings/ethernet/smsc,lan91c111.yaml
```yaml
# SPDX-FileCopyrightText: <text>Copyright 2023 Arm Limited and/or its
# affiliates <open-source-office@arm.com></text>
#
# SPDX-License-Identifier: Apache-2.0
---
description: SMSC (now Microchip) LAN91C111 Ethernet controller

compatible: "smsc,lan91c111"

include: base.yaml

properties:
  reg:
    required: true

  interrupts:
    required: true
```

## components/safety_island/zephyr/src/dts/bindings/fault_mgmt/arm,fmu.yaml
```yaml
# SPDX-FileCopyrightText: <text>Copyright 2023 Arm Limited and/or its
# affiliates <open-source-office@arm.com></text>
#
# SPDX-License-Identifier: Apache-2.0
---
description: ARM FMU (Fault Management Unit)

compatible: "arm,fmu"

include: base.yaml

properties:
  reg:
    required: true

  upstream:
    type: phandles

  safety:
    type: phandle
```

## components/safety_island/zephyr/src/dts/bindings/fault_mgmt/arm,ssu.yaml
```yaml
# SPDX-FileCopyrightText: <text>Copyright 2023 Arm Limited and/or its
# affiliates <open-source-office@arm.com></text>
#
# SPDX-License-Identifier: Apache-2.0
---
description: ARM SSU (Safety Status Unit)

compatible: "arm,ssu"

include: base.yaml

properties:
  reg:
    required: true
```

## components/safety_island/zephyr/src/dts/bindings/fault_mgmt/zephyr,fault-mgmt.yaml
```yaml
# SPDX-FileCopyrightText: <text>Copyright 2023 Arm Limited and/or its
# affiliates <open-source-office@arm.com></text>
#
# SPDX-License-Identifier: Apache-2.0
---
description: Fault management subsystem

compatible: "zephyr,fault-mgmt"

properties:
  root-fmus:
    type: phandles
```

## components/safety_island/zephyr/src/dts/bindings/mbox/mbox-bindings.yaml
```yaml
# SPDX-FileCopyrightText: <text>Copyright 2023 Arm Limited and/or its
# affiliates <open-source-office@arm.com></text>
#
# SPDX-License-Identifier: Apache-2.0
---
description: Mbox Bindings

compatible: "pc-mbox-rpmsg-binding"

include: base.yaml

properties:
  mboxes:
    description: phandle to the MBOX controller (TX and RX are required)
    required: true

  mbox-names:
    description: MBOX channel names (must be called "tx" and "rx")
    required: true
```

## components/safety_island/zephyr/src/dts/bindings/mdio/smsc,lan91c111-mdio.yaml
```yaml
# SPDX-FileCopyrightText: <text>Copyright 2023 Arm Limited and/or its
# affiliates <open-source-office@arm.com></text>
#
# SPDX-License-Identifier: Apache-2.0
---
description: SMSC (now Microchip) LAN91C111 MDIO Driver node

compatible: "smsc,lan91c111-mdio"

include:
  - name: mdio-controller.yaml
```
