## components/safety_island/zephyr/src/dts/bindings/mhuv3/arm,mhuv3-tx.yaml
```yaml
# SPDX-FileCopyrightText: <text>Copyright 2023 Arm Limited and/or its
# affiliates <open-source-office@arm.com></text>
#
# SPDX-License-Identifier: Apache-2.0
---
description: ARM MHUv3 (Message Handling Unit v3)

compatible: "arm,mhuv3-tx"

include: [base.yaml, mailbox-controller.yaml]

properties:
  reg:
    required: true

mbox-cells:
  - channel
```

## components/safety_island/zephyr/src/dts/bindings/psa/arm,ipc-psa.yaml
```yaml
# SPDX-FileCopyrightText: <text>Copyright 2023 Arm Limited and/or its
# affiliates <open-source-office@arm.com></text>
#
# SPDX-License-Identifier: Apache-2.0
---
description: IPC PSA backend binding

compatible: "arm,ipc-psa"

include: base.yaml

properties:
  tx-region:
    description: phandle to the shared memory region used for data transmission
    required: true
    type: phandle

  rx-region:
    description: phandle to the shared memory region used for data reception
    required: true
    type: phandle

  mboxes:
    description: phandle to the MBOX controller (TX and RX are required)
    required: true

  mbox-names:
    description: MBOX channel names (must be called "tx" and "rx")
    required: true
```
