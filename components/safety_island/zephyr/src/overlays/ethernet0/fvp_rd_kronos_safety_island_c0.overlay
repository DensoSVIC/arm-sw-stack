/*
 * SPDX-FileCopyrightText: <text>Copyright 2023 Arm Limited and/or its
 * affiliates <open-source-office@arm.com></text>
 *
 * SPDX-License-Identifier: Apache-2.0
 */

&eth {
	status = "okay";
};

&phy {
	status = "okay";
};

&mdio {
	status = "okay";
};
