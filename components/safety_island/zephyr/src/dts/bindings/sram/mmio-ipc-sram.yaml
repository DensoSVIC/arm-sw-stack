## components/safety_island/zephyr/src/dts/bindings/sram/mmio-ipc-sram.yaml
```yaml
# SPDX-FileCopyrightText: <text>Copyright 2023 Arm Limited and/or its
# affiliates <open-source-office@arm.com></text>
#
# SPDX-License-Identifier: Apache-2.0
---
description: Shared on-chip SRAM description

compatible: "mmio-ipc-sram"

include: base.yaml

properties:
  reg:
    required: true

  busaddr_delta_l:
    type: int
    required: true

  busaddr_delta_h:
    type: int
    required: true
```

## components/safety_island/zephyr/src/modules/psa-arch-tests/Kconfig
```kconfig
#
# SPDX-FileCopyrightText: <text>Copyright 2023 Arm Limited and/or its
# affiliates <open-source-office@arm.com></text>
#
# SPDX-License-Identifier: Apache-2.0

choice PSA_ARCH_TEST
	prompt "Enable a PSA Architecture test suite"
	default PSA_ARCH_TEST_NONE

config PSA_ARCH_TEST_PROTECTED_STORAGE
	bool "PSA Protected Storage tests"
	depends on PSA_PROTECTED_STORAGE_API
	help
	  Enable the PSA Protected Storage test suite.

config PSA_ARCH_TEST_INTERNAL_TRUSTED_STORAGE
	bool "PSA Internal Trusted Storage tests"
	depends on PSA_INTERNAL_TRUSTED_STORAGE_API
	help
	  Enable the PSA Internal Trusted Storage test suite.

config PSA_ARCH_TEST_STORAGE
	bool "PSA Storage tests"
	depends on PSA_PROTECTED_STORAGE_API && PSA_INTERNAL_TRUSTED_STORAGE_API
	help
	  Enable the PSA Storage test suite. This is a combination of the
	  Protected Storage and Internal Trusted Storage tests.

config PSA_ARCH_TEST_CRYPTO
	bool "PSA Crypto tests"
	depends on MAIN_STACK_SIZE >= 4096
	help
	  Enable the PSA Crypto test suite.

config PSA_ARCH_TEST_NONE
	bool "No PSA test suite"

endchoice

choice PSA_ARCH_TEST_API_HEADERS
	prompt "Select which API header files to enable the PSA Arch Tests suite"
	default PSA_ARCH_TEST_API_TFM_HEADERS
	help
	  It defines an additional directory to be included into the
	  compiler search path. Users must select a PSA API header files
	  implementation for test suite build system.

config PSA_ARCH_TEST_API_TFM_HEADERS
	bool "Select the TF-M PSA API header files"
	help
	  Select the TF-M PSA API header files to enable the PSA Arch Tests suite.

config PSA_ARCH_TEST_API_MBEDTLS_HEADERS
	depends on MBEDTLS && PSA_ARCH_TEST_CRYPTO && \
			   (!PSA_ARCH_TEST_PROTECTED_STORAGE || \
			   !PSA_ARCH_TEST_INTERNAL_TRUSTED_STORAGE || \
			   !PSA_ARCH_TEST_STORAGE)
	bool "Select the Mbed TLS PSA Crypto API header files"
	help
	  Select the Mbed TLS PSA Crypto API header files to enable the PSA
	  Arch Crypto Tests suite.

endchoice
```

## components/safety_island/zephyr/src/modules/trusted-firmware-m/Kconfig
```kconfig
#
# SPDX-FileCopyrightText: <text>Copyright 2023 Arm Limited and/or its
# affiliates <open-source-office@arm.com></text>
#
# SPDX-License-Identifier: Apache-2.0

config TFM_PSA_PROTECTED_STORAGE_API
    bool "TF-M PSA Protected Storage API"
    select PSA
    select PSA_PROTECTED_STORAGE_API

config TFM_PSA_INTERNAL_TRUSTED_STORAGE_API
    bool "TF-M PSA Internal Trusted Storage API"
    select PSA
    select PSA_INTERNAL_TRUSTED_STORAGE_API
```

## components/safety_island/zephyr/src/subsys/Kconfig
```kconfig
#
# SPDX-FileCopyrightText: <text>Copyright 2023 Arm Limited and/or its
# affiliates <open-source-office@arm.com></text>
#
# SPDX-License-Identifier: Apache-2.0

menu "Subsystems"
rsource "fault_mgmt/Kconfig"
rsource "ipc/psa_service/Kconfig"
endmenu
```

## components/safety_island/zephyr/src/subsys/fault_mgmt/Kconfig
```kconfig
#
# SPDX-FileCopyrightText: <text>Copyright 2023 Arm Limited and/or its
# affiliates <open-source-office@arm.com></text>
#
# SPDX-License-Identifier: Apache-2.0

menuconfig FAULT_MGMT
	bool "Fault management"
	help
	  Enable the fault management subsystem

if FAULT_MGMT

config FAULT_MGMT_STACK_SIZE
	int "Fault management stack size"
	default 1024

config FAULT_MGMT_QUEUE_SIZE_CRITICAL
	int "Fault management receive queue size for critical faults"
	default 64

config FAULT_MGMT_QUEUE_SIZE_NON_CRITICAL
	int "Fault management receive queue size for non-critical faults"
	default 64

config FAULT_MGMT_THREAD_PRIORITY_CRITICAL
	int "Fault management thread priority for critical fault processing"
	default 10

config FAULT_MGMT_THREAD_PRIORITY_NON_CRITICAL
	int "Fault management thread priority for non-critical fault processing"
	default 5

config FAULT_MGMT_SHELL
	bool "Fault management shell"
	select SHELL
	help
	  Activate shell module that provides commands to manually inspect and
	  control the Arm fault management subsystem.

config FAULT_MGMT_SAFETY
	bool "Fault management safety state integration"
	help
	  Control and report the status of an attached safety state management
	  device in response to faults

menuconfig FAULT_MGMT_STORAGE
	bool "fault management storage"
	default n
	select SYS_HASH_MAP
	help
	  If selected, enables the fault storage feature which requires a
	  subsequent choice of storage backend.

if FAULT_MGMT_STORAGE

choice
	prompt "Select fault management storage backend"
	optional

config FAULT_MGMT_STORAGE_SYS_HASH_MAP
	bool "Use system hash map for fault storage"
	help
	  Utilize the system hash map as the backend for storing fault records.

config FAULT_MGMT_PSA_PROTECTED_STORAGE
	bool "Use PSA Protected Storage for fault management"
	select PSA
	select TFM_PSA_PROTECTED_STORAGE_API
	help
	  Utilize PSA Protected Storage as the backend for storing fault records.

endchoice

if FAULT_MGMT_PSA_PROTECTED_STORAGE

config FAULT_MGMT_NAMESPACE_ID
	hex "Configure UID namespace for PSA Protected Storage"
	default 0xAAFF5500
	help
	  Specify the unique identifier (UID) namespace for storing
	  fault records in the PSA Protected Storage.

config MAX_PSA_PROTECTED_STORAGE_SIZE
	int "Fault management PSA storage size"
	default 50
	help
	  Specify the maximum number of new fault records that can be stored
	  or allocated in the PSA Protected Storage. Currently, there is a
	  limitation where the maximum storage size is capped at 50.

endif
endif

module = FAULT_MGMT
module-str = Fault management
source "subsys/logging/Kconfig.template.log_config"

endif
```

## components/safety_island/zephyr/src/subsys/ipc/psa_service/Kconfig
```kconfig
#
# SPDX-FileCopyrightText: <text>Copyright 2023 Arm Limited and/or its
# affiliates <open-source-office@arm.com></text>
#
# SPDX-License-Identifier: Apache-2.0

menuconfig PSA
	bool "PSA Service"
	select POLL
	help
	  Enable the PSA Service subsystem

if PSA

config PSA_PROTECTED_STORAGE_API
	bool "PSA Protected Storage API"

config PSA_INTERNAL_TRUSTED_STORAGE_API
	bool "PSA Internal Trusted Storage API"

module = PSA_SERVICE
module-str = psa_service
source "subsys/logging/Kconfig.template.log_config"

endif
```

## components/safety_island/zephyr/src/subsys/ipc/psa_service/psa/Kconfig
```kconfig
#
# SPDX-FileCopyrightText: <text>Copyright 2023 Arm Limited and/or its
# affiliates <open-source-office@arm.com></text>
#
# SPDX-License-Identifier: Apache-2.0

if PSA

config PSA_INTERNAL_TRUSTED_STORAGE
	bool "PSA Internal Trusted Storage"
	help
	  Activate PSA Internal Trusted Storage

config PSA_PROTECTED_STORAGE
	bool "PSA Protected Storage"
	help
	  Activate PSA Protected Storage

module = PSA_API
module-str = PSA API
source "subsys/logging/Kconfig.template.log_config"

endif
```

## yocto/meta-arm-auto-solutions/conf/machine/include/fvp-rd-kronos-cassini-extra-settings.inc
```bitbake
#
# SPDX-FileCopyrightText: <text>Copyright 2023-2024 Arm Limited and/or its
# affiliates <open-source-office@arm.com></text>
#
# SPDX-License-Identifier: MIT

PREFERRED_PROVIDER_virtual/kernel = "linux-yocto-rt"

PREFERRED_VERSION_zephyr-kernel = "3.5.0"
ZEPHYR_INHERIT_CLASSES:append = " zephyr-arm-safety-island"
ZEPHYR_TOOLCHAIN_VARIANT = "zephyr"

SAFETY_ISLAND_C0_RECIPE ??= "zephyr-app-si-cl0"
SAFETY_ISLAND_C1_RECIPE ??= "zephyr-app-si-cl1"
SAFETY_ISLAND_C2_RECIPE ??= "zephyr-app-si-cl2"

SAFETY_ISLAND_C0_IMAGE ??= "${SAFETY_ISLAND_C0_RECIPE}"
SAFETY_ISLAND_C1_IMAGE ??= "${SAFETY_ISLAND_C1_RECIPE}"
SAFETY_ISLAND_C2_IMAGE ??= "${SAFETY_ISLAND_C2_RECIPE}"

FVP_SI1_BRIDGED_HOST_NETPORT ?= "6002"
FVP_SI2_BRIDGED_HOST_NETPORT ?= "6003"
FVP_ACTUATION_HOST_ANALYZER_PORT ?= "49152"
FVP_CONFIG[css.sysctrl.si.ethernet0.enabled] ?= "1"
FVP_CONFIG[css.sysctrl.si.hostbridge0.userNetworking] ?= "1"
FVP_CONFIG[css.sysctrl.si.hostbridge0.userNetSubnet] ?= "192.168.10.0/24"
FVP_CONFIG[css.sysctrl.si.hostbridge0.userNetPorts] ?= "\
        ${FVP_SI1_BRIDGED_HOST_NETPORT}=192.168.10.1:5001, \
        ${FVP_SI2_BRIDGED_HOST_NETPORT}=192.168.10.2:5001, \
        ${FVP_ACTUATION_HOST_ANALYZER_PORT}=192.168.10.2:49152 \
"

AHCI_IMAGE_PATH ?= ""
FVP_CONFIG[pcie_group_0.pcie4.pcie_rc.ahci0.ahci.image_path] = "${AHCI_IMAGE_PATH}"

TEST_FVP_LINUX_BOOT_TIMEOUT = "${@60*60}"
```
