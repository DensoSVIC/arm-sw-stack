## yocto/meta-arm-bsp-extras/conf/machine/fvp-rd-kronos.conf
```bitbake
#
# SPDX-FileCopyrightText: <text>Copyright 2023-2024 Arm Limited and/or its
# affiliates <open-source-office@arm.com></text>
#
# SPDX-License-Identifier: MIT

# Configuration for Fixed Virtual Platform Reference Design Kronos Machine

#@TYPE: Machine
#@NAME: FVP RD-Kronos Machine
#@DESCRIPTION: Machine configuration for FVP RD-Kronos

# Use neoverse-v2 tune parameters for now
require conf/machine/include/arm/armv9a/tune-neoversev2.inc

SVE_DISABLE_FLAG ?= "0"
# Adjust SVE-related compiler flags based on 'SVE_DISABLE_FLAG'.
# When 'SVE_DISABLE_FLAG' is set to '1', add '+nosve' to 'TUNE_CCARGS_MARCH_OPTS'
# to exclude SVE support.
TUNE_CCARGS_MARCH_OPTS .= "${@'+nosve' if d.getVar('SVE_DISABLE_FLAG', True) == '1' else ''}"

# Trusted Services
TS_PLATFORM = "arm/kronos"
TS_SP_SE_PROXY_CONFIG = "kronos"

ARM_SYSTEMREADY_FIRMWARE = "firmware-${MACHINE}:do_deploy"
ARM_SYSTEMREADY_ACS_CONSOLE ?= "default"
EXTRA_IMAGEDEPENDS = "${ARM_SYSTEMREADY_FIRMWARE}"

MMC_IMAGE ?= "${DEPLOY_DIR_IMAGE}/efi-capsule-update-disk-image-${MACHINE}.img"

ARM_SYSTEMREADY_CAPSULE_UPDATE ?= "1"
EXTRA_IMAGEDEPENDS += " \
    ${@bb.utils.contains('ARM_SYSTEMREADY_CAPSULE_UPDATE', '1', ' \
        efi-capsule-update-disk-image-${MACHINE}:do_deploy', '', d)} \
    "

PREFERRED_PROVIDER_virtual/bootloader ?= "u-boot"
PREFERRED_PROVIDER_virtual/kernel ?= "linux-yocto"
PREFERRED_VERSION_linux-yocto = "6.6%"
PREFERRED_VERSION_linux-yocto-rt = "6.6%"
PREFERRED_VERSION_optee-os = "3.22.0"
PREFERRED_VERSION_python3-pyhsslms-native = "1.1%"
PREFERRED_VERSION_scp-firmware = "2.13.%"
PREFERRED_VERSION_trusted-firmware-a ?= "2.8.%"
PREFERRED_VERSION_trusted-firmware-m = "1.8.1"
PREFERRED_VERSION_trusted-firmware-m-scripts-native = "1.8.1"
PREFERRED_VERSION_u-boot ?= "2023.07%"

KERNEL_IMAGETYPE = "Image"
SERIAL_CONSOLES = "115200;ttyAMA0"
UBOOT_MACHINE = "vexpress_fvp_defconfig"

IMAGE_CLASSES += "fvpboot"

IMAGE_FSTYPES += "wic"
IMAGE_NAME_SUFFIX = ""
WKS_FILE ?= "${MACHINE}-efi-disk.wks.in"
EFI_PROVIDER ?= "grub-efi"
MACHINE_FEATURES:append = " efi arm-ffa ts-se-proxy ts-smm-gateway"
GRUB_LINUX_APPEND ?= ""
IMAGE_CMD:wic[vardeps] += "GRUB_LINUX_APPEND"

TEST_TARGET = "OEFVPTarget"
TEST_TARGET_IP ?= "127.0.0.1:2222"
TEST_SERVER_IP ?= "127.0.1.1"
TEST_SUITES = "\
    ping \
    ssh \
    test_00_rss \
    test_00_secure_partition \
    fvp_boot \
    fvp_devices \
    "
TEST_FVP_DEVICES ?= "rtc watchdog networking virtiorng cpu_hotplug"
TEST_FVP_LINUX_BOOT_TIMEOUT ?= "${@30*60}"

MACHINE_EXTRA_RRECOMMENDS += "ssh-pregen-hostkeys"

# We don't need to automount the /boot partition
WIC_CREATE_EXTRA_ARGS += "--no-fstab-update"

# Don't include kernel binary in rootfs /boot path
RRECOMMENDS:${KERNEL_PACKAGE_NAME}-base = ""

# TF-M settings for signing host images
RE_LAYOUT_WRAPPER_VERSION = "0.0.7"
TFM_SIGN_PRIVATE_KEY = "${libdir}/tfm-scripts/root-RSA-3072.pem"
RE_IMAGE_OFFSET = "0x400"

SAFETY_ISLAND_RECIPE ??= "si-hello-world"
SAFETY_ISLAND_C0_RECIPE ??= "${SAFETY_ISLAND_RECIPE}"
SAFETY_ISLAND_C1_RECIPE ??= "${SAFETY_ISLAND_RECIPE}"
SAFETY_ISLAND_C2_RECIPE ??= "${SAFETY_ISLAND_RECIPE}"

SAFETY_ISLAND_C0_IMAGE ??= "${SAFETY_ISLAND_C0_RECIPE}"
SAFETY_ISLAND_C1_IMAGE ??= "${SAFETY_ISLAND_C1_RECIPE}"
SAFETY_ISLAND_C2_IMAGE ??= "${SAFETY_ISLAND_C2_RECIPE}"

RSS_NVM_IMAGE = "rss-nvm-image.img"

FASTSIM_DISABLE_TA = "0"

FVP_PROVIDER ?= "fvp-rd-kronos-native"
FVP_EXE ?= "FVP_RD_Kronos"
FVP_CONSOLES[default] = "terminal_ns_uart0"
FVP_CONSOLES[tf-a] = "terminal_sec_uart"
FVP_CONSOLES[scp] = "terminal_uart_scp"
FVP_CONSOLES[lcp] = "terminal_uart_lcp"
FVP_CONSOLES[rss] = "terminal_rse_uart"
FVP_CONSOLES[safety_island_c0] = "terminal_uart_si_cluster0"
FVP_CONSOLES[safety_island_c1] = "terminal_uart_si_cluster1"
FVP_CONSOLES[safety_island_c2] = "terminal_uart_si_cluster2"

FVP_TERMINALS[css.ap_periph.terminal_ns_uart0] = "PC Console"
FVP_TERMINALS[css.ap_periph.terminal_sec_uart] = "PC Secure Console"
FVP_TERMINALS[css.sysctrl.scp.terminal_uart_scp] = "SCP"
FVP_TERMINALS[css.sysctrl.scp.terminal_uart_lcp] = "LCP"
FVP_TERMINALS[css.sysctrl.terminal_rse_uart] = "RSS"
FVP_TERMINALS[css.sysctrl.si.terminal_uart_si_cluster0] = "SI C0"
FVP_TERMINALS[css.sysctrl.si.terminal_uart_si_cluster1] = "SI C1"
FVP_TERMINALS[css.sysctrl.si.terminal_uart_si_cluster2] = "SI C2"

FVP_CONFIG[ros.disable_visualisation] = "1"
FVP_CONFIG[css.sysctrl.si.disable_visualisation] = "1"

FVP_CONFIG[css.sysctrl.rse.rom.raw_image] = "${DEPLOY_DIR_IMAGE}/rss-rom-image.img"
FVP_CONFIG[css.sysctrl.rse_flashloader.fname] = "${DEPLOY_DIR_IMAGE}/rss-flash-image.img"
FVP_CONFIG[ros.board.mmc.p_mmc_file] = "${MMC_IMAGE}"
FVP_CONFIG[ros.board.virtioblockdevice.image_path] = "${DEPLOY_DIR_IMAGE}/${IMAGE_LINK_NAME}.wic"
FVP_CONFIG[ros.board.virtio_net.enabled] ?= "1"
FVP_CONFIG[ros.board.virtio_net.hostbridge.userNetworking] ?= "1"
FVP_CONFIG[ros.board.virtio_net.hostbridge.userNetPorts] ?= "2222=22"
FVP_CONFIG[ros.board.virtio_net.transport] ?= "legacy"
FVP_CONFIG[ros.board.virtio_rng.enabled] ?= "1"
FVP_CONFIG[ros.board.flashloader0.fname] = "${DEPLOY_DIR_IMAGE}/ap-flash-image.img"
FVP_CONFIG[ros.dram_size] = "0x100000000"

FVP_CONFIG[css.sysctrl.rse.DISABLE_GATING] = "1"

FVP_CONFIG[css.sysctrl.scp.ap2scp_mhu_s.NUM_DB_CH] = "6"
FVP_CONFIG[css.sysctrl.scp.scp2ap_mhu_s.NUM_DB_CH] = "6"

FVP_CONFIG[css.sysctrl.scp.ap2scp_mhu_s.NUM_DB_CH] = "6"
FVP_CONFIG[css.sysctrl.scp.scp2ap_mhu_s.NUM_DB_CH] = "6"

FVP_CONFIG[css.sysctrl.rse.CMU4_NUM_DB_CH] = "7"

# Set SI secondary core RVBARs to the same as the primary cores
FVP_CONFIG[css.sysctrl.si.system_ctrl_regs.cl1_c1_cfgrvbaraddr] = "0x140000000"
FVP_CONFIG[css.sysctrl.si.system_ctrl_regs.cl2_c1_cfgrvbaraddr] = "0x160000000"
FVP_CONFIG[css.sysctrl.si.system_ctrl_regs.cl2_c2_cfgrvbaraddr] = "0x160000000"
FVP_CONFIG[css.sysctrl.si.system_ctrl_regs.cl2_c3_cfgrvbaraddr] = "0x160000000"

# Add PCIe AHCI device for testing gicv4.1 vLPI direct injection
FVP_CONFIG[pcie_group_0.pcie4.hierarchy_file_name]= "<default>"
FVP_CONFIG[pcie_group_0.pcie4.pcie_rc.ahci0.endpoint.ats_supported]= "true"
FVP_CONFIG[pcie_group_0.pcie4.pcie_rc.ahci0.ahci.image_path]= ""

# Set SMMU RME-unaware
FVP_CONFIG[pcie_group_0.pcie4.pci_smmuv3.mmu.SMMU_ROOT_IDR0]= "0"

# Enable Flash saving
FVP_CONFIG[css.sysctrl.rse_flashloader.fnameWrite] = "${DEPLOY_DIR_IMAGE}/rss-flash-image.img"
FVP_CONFIG[css.sysctrl.rse_flashloader.write_flash_after_reset] = "true"
FVP_CONFIG[ros.board.flashloader0.fnameWrite] = "${DEPLOY_DIR_IMAGE}/ap-flash-image.img"
FVP_CONFIG[ros.board.flashloader0.write_flash_after_reset] = "true"

# Enable NV Counters persistence
FVP_CONFIG[css.sysctrl.rse.lcm_nvm.otp_enabled] = "1"
FVP_CONFIG[css.sysctrl.rse.lcm_nvm.raw_image] = "${DEPLOY_DIR_IMAGE}/${RSS_NVM_IMAGE}"
FVP_CONFIG[css.sysctrl.rse.lcm_nvm.read_from_file] = "1"
FVP_CONFIG[css.sysctrl.rse.lcm_nvm.update_raw_image] = "1"
FVP_CONFIG[css.sysctrl.rse.lcm_nvm.use_image_file] = "1"

# Set RSS clock frequency multiplier
FVP_CONFIG[css.sysctrl.rse.clk_mul.mul] = "5"

FVP_DATA = "css.sysctrl.rse.cpu=${DEPLOY_DIR_IMAGE}/encrypted_cm_provisioning_bundle_0.bin@0x31000000 \
            css.sysctrl.rse.cpu=${DEPLOY_DIR_IMAGE}/encrypted_dm_provisioning_bundle.bin@0x31080000"

# Add shutdown tag to be able to shutdown the FVP
FVP_CONFIG[css.sysctrl.rse_uart.shutdown_tag] = "System shutdown complete"
```

## yocto/meta-arm-safety-island/conf/layer.conf
```bitbake
#
# SPDX-FileCopyrightText: <text>Copyright 2024 Arm Limited and/or its
# affiliates <open-source-office@arm.com></text>
#
# SPDX-License-Identifier: MIT

# We have a conf and classes directory, add to BBPATH
BBPATH .= ":${LAYERDIR}"

# We have recipes-* directories, add to BBFILES
BBFILES += "${LAYERDIR}/recipes-*/*/*.bb \
            ${LAYERDIR}/recipes-*/*/*.bbappend"

BBFILE_COLLECTIONS += "meta-arm-safety-island"
BBFILE_PATTERN_meta-arm-safety-island = "^${LAYERDIR}/"

LAYERDEPENDS_meta-arm-safety-island = "\
    core \
    zephyrcore \
"
LAYERSERIES_COMPAT_meta-arm-safety-island = "scarthgap"

ERROR_QA:append:layer-meta-arm-safety-island = " patch-status"

ARM_AUTO_SOLUTIONS_REPO_DIRECTORY = "${LAYERDIR}/../../"

addpylib ${LAYERDIR}/lib oeqa
```

## yocto/meta-kronos/conf/machine/include/fvp-rd-kronos-extras.inc
```bitbake
#
# SPDX-FileCopyrightText: <text>Copyright 2023 Arm Limited and/or its
# affiliates <open-source-office@arm.com></text>
#
# SPDX-License-Identifier: MIT

ZEPHYR_INHERIT_CLASSES:append = " zephyr-machine-extras"
ZEPHYR_TOOLCHAIN_VARIANT = "zephyr"

SAFETY_ISLAND_C0_RECIPE ??= "zephyr-app-si-cl0"
SAFETY_ISLAND_C1_RECIPE ??= "zephyr-app-si-cl1"
SAFETY_ISLAND_C2_RECIPE ??= "zephyr-app-si-cl2"

SAFETY_ISLAND_C0_IMAGE ??= "${SAFETY_ISLAND_C0_RECIPE}"
SAFETY_ISLAND_C1_IMAGE ??= "${SAFETY_ISLAND_C1_RECIPE}"
SAFETY_ISLAND_C2_IMAGE ??= "${SAFETY_ISLAND_C2_RECIPE}"

FVP_SI0_ETHERNET0_HOST_NETPORT ?= "6001"
FVP_CONFIG[css.sysctrl.si.ethernet0.enabled] ?= "1"
FVP_CONFIG[css.sysctrl.si.hostbridge0.userNetworking] ?= "1"
FVP_CONFIG[css.sysctrl.si.hostbridge0.userNetPorts] ?= \
        "${FVP_SI0_ETHERNET0_HOST_NETPORT}=172.20.51.1:5001"

TEST_FVP_LINUX_BOOT_TIMEOUT = "${@30*60}"

require ${@bb.utils.contains('EXTRA_IMAGE_FEATURES', 'virtualization', "conf/machine/include/fvp-rd-kronos-virtualization.inc", '', d)}
```

## yocto/meta-kronos/dynamic-layers/virtualization-layer/wic/domu-disk.wks
```
#
# SPDX-FileCopyrightText: <text>Copyright 2023 Arm Limited and/or its
# affiliates <open-source-office@arm.com></text>
#
# SPDX-License-Identifier: MIT

part / --source rootfs --fstype=ext4 --label root --align 1024 --use-uuid

bootloader --ptable gpt
```
