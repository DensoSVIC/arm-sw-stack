/*
 * SPDX-FileCopyrightText: <text>Copyright 2023-2024 Arm Limited and/or its
 * affiliates <open-source-office@arm.com></text>
 *
 * SPDX-License-Identifier: Apache-2.0
 */

#include <zephyr/dt-bindings/memory-attr/memory-attr-arm.h>
/ {
	soc {
		device_region_0: memory@8000000 {
			compatible = "zephyr,memory-region", "mmio-sram";
			reg = <0x0 0x8000000 DT_SIZE_M(128)>;
			zephyr,memory-region = "DEVICE_REGION_0";
			zephyr,memory-attr = <( DT_MEM_ARM(ATTR_MPU_IO) )>;
		};

		device_region_1: memory@2a000000 {
			compatible = "zephyr,memory-region", "mmio-sram";
			reg = <0x0 0x2a000000 DT_SIZE_M(352)>;
			zephyr,memory-region = "DEVICE_REGION_1";
			zephyr,memory-attr = <( DT_MEM_ARM(ATTR_MPU_IO) )>;
		};
	};
};
