## CMakeLists.txt
```
cmake_minimum_required(VERSION 3.13.1)

set(CONF_FILE "prj.conf")

list(APPEND ZEPHYR_EXTRA_MODULES ${CMAKE_CURRENT_SOURCE_DIR}/modules/libmicroxrcedds)

find_package(Zephyr REQUIRED HINTS $ENV{ZEPHYR_BASE})

project(zephyr_ebs)

target_sources(app PRIVATE 
    src/main.c 
    src/sensor_dds.h
    src/sensor_dds.c
    src/brake_feedback_dds.h
    src/brake_feedback_dds.c
    src/VehicleEmergencyStamped.h
    src/VehicleEmergencyStamped.c
)
```

## Kconfig
```
config NET_IFACE1_ADDR
	string "Address for interface 1"
	default ""

config NET_IFACE1_GW
	string "Gateway for interface 1"
	default ""

config NET_IFACE1_NETMASK
	string "Netmask for interface 1"
	default ""

config NET_IFACE1_VLAN
	int "VLAN identifier for interface 1"
	default 0
	help
	  When different from 0, it sets the VLAN id for the interface 1.
	  Use 0 here if uncertain.

config NET_IFACE2_ADDR
	string "Address for interface 2"
	default ""

config NET_IFACE2_GW
	string "Gateway for interface 2"
	default ""

config NET_IFACE2_NETMASK
	string "Netmask for interface 2"
	default ""

config NET_IFACE2_VLAN
	int "VLAN identifier for interface 2"
	default 0
	help
	  When different from 0, it sets the VLAN id for the interface 2.
	  Use 0 here if uncertain.

source "Kconfig.zephyr"
```

## prj.conf
```kconfig
CONFIG_POSIX_API=y
CONFIG_EVENTS=y

CONFIG_MAIN_STACK_SIZE=25000
CONFIG_MAIN_THREAD_PRIORITY=3

CONFIG_NEWLIB_LIBC=y
CONFIG_NEWLIB_LIBC_NANO=n
CONFIG_PTHREAD_IPC=n

# networking config
CONFIG_NETWORKING=y
CONFIG_NET_L2_ETHERNET=y
CONFIG_NET_IPV4=y
CONFIG_NET_SOCKETS=y
CONFIG_NET_CONFIG_SETTINGS=y
CONFIG_NET_CONFIG_AUTO_INIT=y
CONFIG_NET_CONFIG_NEED_IPV4=y
CONFIG_NET_SOCKETS_PACKET=y
CONFIG_NET_SOCKETS_PACKET_DGRAM=y
CONFIG_NET_SOCKETPAIR=y

CONFIG_NET_UDP=y
CONFIG_NET_UDP_CHECKSUM=y

CONFIG_NET_TCP=y
CONFIG_NET_TCP_ISN_RFC6528=n
CONFIG_NET_TCP_WORKQ_STACK_SIZE=4096

# Network address config
CONFIG_NET_CONFIG_SETTINGS=y
CONFIG_NET_MGMT=y
CONFIG_NET_MGMT_EVENT_STACK_SIZE=4096

# Misc. config
CONFIG_TEST_RANDOM_GENERATOR=y

# Logging config
CONFIG_NET_LOG=y
CONFIG_ETHERNET_LOG_LEVEL_DBG=y

# Console/shell config
CONFIG_CONSOLE=y
CONFIG_UART_CONSOLE=y
CONFIG_UART_INTERRUPT_DRIVEN=y
CONFIG_SHELL=y
CONFIG_NET_SHELL=y
```

## boards/fvp_rd_kronos_safety_island_c2_ebs.conf
```kconfig
CONFIG_NET_CONFIG_SETTINGS=n

CONFIG_IPC_RPMSG_VETH_SI_IPV4_ADDR_0=""
CONFIG_IPC_RPMSG_VETH_SI_NETMASK_0=""

CONFIG_NET_IFACE1_ADDR="192.168.2.1"
CONFIG_NET_IFACE1_NETMASK="255.255.255.0"
CONFIG_NET_IFACE1_VLAN=300

CONFIG_NET_IFACE2_ADDR="192.168.10.2"
CONFIG_NET_IFACE2_GW="192.168.10.254"
CONFIG_NET_IFACE2_NETMASK="255.255.255.0"
```

## src/main.c
```c
#include <zephyr/kernel.h>
#include <zephyr/net/net_if.h>
#include <zephyr/net/ethernet.h>
#include <stdio.h>
#include <string.h>
#include <stdlib.h>
#include <time.h>

#ifdef CONFIG_GPIO_RCAR
#include <zephyr/drivers/led.h>
#include <zephyr/drivers/gpio.h>
#endif

#include "brake_feedback_dds.h"
#include "sensor_dds.h"
#ifdef CONFIG_GPIO_RCAR
#include "gpio4_button.h"
#endif

#define MAX_IFACES 2
#define STREAM_HISTORY  8
#define BUFFER_SIZE     UXR_CONFIG_UDP_TRANSPORT_MTU* STREAM_HISTORY

extern struct k_event SENSOR_DDS_SETUP_EVENT;
extern struct k_event BRAKE_DDS_SETUP_EVENT;

enum SENSOR_DDS_EVENTS 
{
    SENSOR_DDS_NO_DDS = 0b01,
    SENSOR_DDS_CONNECTED = 0b10
};

enum BRAKE_DDS_EVENTS 
{
    BRAKE_DDS_NO_DDS = 0b01,
    BRAKE_DDS_CONNECTED = 0b10
};

K_THREAD_DEFINE(brake_dds_setup_tid, 10000, brake_dds_setup, NULL, NULL, NULL, 5, 0, 0);
K_THREAD_DEFINE(brake_dds_process_tid, 10000, brake_dds_process, NULL, NULL, NULL, 5, 0, 0);
K_THREAD_DEFINE(brake_dds_check_tid, 10000, brake_dds_check, NULL, NULL, NULL, 5, 0, 0);

K_THREAD_DEFINE(sensor_dds_setup_tid, 10000, sensor_dds_setup, NULL, NULL, NULL, 5, 0, 0);
K_THREAD_DEFINE(sensor_dds_process_tid, 10000, sensor_dds_process, NULL, NULL, NULL, 5, 0, 0);

#ifdef CONFIG_GPIO_RCAR
#define LED0_NODE DT_ALIAS(led0)
#define LED1_NODE DT_ALIAS(led1)
#define LED2_NODE DT_ALIAS(led2)

static const struct led_dt_spec led0 = LED_DT_SPEC_GET(LED0_NODE);
static const struct led_dt_spec led1 = LED_DT_SPEC_GET(LED1_NODE);
static const struct led_dt_spec led2 = LED_DT_SPEC_GET(LED2_NODE);
#endif

struct iface_list {
    struct net_if *ifaces[MAX_IFACES];
    int count;
};

static void net_if_cb(struct net_if *iface, void *user_data)
{
    struct iface_list *ctx = (struct iface_list *)user_data;
    
    if (ctx->count < MAX_IFACES) {
        ctx->ifaces[ctx->count++] = iface;
    }
}

static int setup_iface(struct net_if *iface, const char *addr, const char *gw, 
                       const char *netmask, uint16_t tag)
{
    struct in_addr inaddr;

    if (net_addr_pton(AF_INET, addr, &inaddr)) {
        printf("Invalid address: %s\n", addr);
        return 1;
    }

    if (!net_if_ipv4_addr_add(iface, &inaddr, NET_ADDR_MANUAL, 0)) {
        printf("Cannot add %s to interface %p\n", addr, iface);
        return 1;
    }

    if (net_addr_pton(AF_INET, gw, &inaddr)) {
        printf("Invalid address: %s\n", gw);
        return 1;
    }
    net_if_ipv4_set_gw(iface, &inaddr);

    if (net_addr_pton(AF_INET, netmask, &inaddr)) {
        printf("Invalid address: %s\n", netmask);
        return 1;
    }
    net_if_ipv4_set_netmask(iface, &inaddr);

#if defined(CONFIG_NET_VLAN)
    if (tag > 0) {
        int ret = net_eth_vlan_enable(iface, tag);
        if (ret < 0) {
            printf("Cannot set VLAN tag %d to interface %p\n", tag, iface);
            return 1;
        }
    }
#endif

    return 0;
}

int main(void)
{
    struct iface_list ifs = {0};
    net_if_foreach(net_if_cb, &ifs);
    if (ifs.count >= 1 && sizeof(CONFIG_NET_IFACE1_ADDR) > 1) {
        int ret = setup_iface(
            ifs.ifaces[0],
            CONFIG_NET_IFACE1_ADDR,
            CONFIG_NET_IFACE1_GW,
            CONFIG_NET_IFACE1_NETMASK,
            CONFIG_NET_IFACE1_VLAN
        );
        if (ret) {
            return 1;
        }
    }

    if (ifs.count >= 2 && sizeof(CONFIG_NET_IFACE2_ADDR) > 1) {
        int ret = setup_iface(
            ifs.ifaces[1],
            CONFIG_NET_IFACE2_ADDR,
            CONFIG_NET_IFACE2_GW,
            CONFIG_NET_IFACE2_NETMASK,
            CONFIG_NET_IFACE2_VLAN
        );
        if (ret) {
            return 1;
        }
    }

    #ifdef CONFIG_GPIO_RCAR
    led_off_dt(&led0);
    led_off_dt(&led1);
    led_off_dt(&led2);

    button_setup();
    #endif

    k_event_set(&SENSOR_DDS_SETUP_EVENT, SENSOR_DDS_NO_DDS);
    k_event_set(&BRAKE_DDS_SETUP_EVENT, BRAKE_DDS_NO_DDS);

    while(1) { 
        
        if(k_thread_join(brake_dds_setup_tid, K_NO_WAIT) != -EBUSY) 
        {
            printf("brake_dds_setup_tid thread exited!!!\n");
        }

        if(k_thread_join(brake_dds_process_tid, K_NO_WAIT) != -EBUSY) 
        {
            printf("brake_dds_process_tid thread exited!!!\n");
        }

        if(k_thread_join(brake_dds_check_tid, K_NO_WAIT) != -EBUSY) 
        {
            printf("brake_dds_check_tid thread exited!!!\n");
        }

        if(k_thread_join(sensor_dds_setup_tid, K_NO_WAIT) != -EBUSY) 
        {
            printf("sensor_dds_setup_tid thread exited!!!\n");
        }

        if(k_thread_join(sensor_dds_process_tid, K_NO_WAIT) != -EBUSY) 
        {
            printf("sensor_dds_process_tid thread exited!!!\n");
        }

        k_sleep(K_SECONDS(2)); 

        printf("[%07lli] Alive!\n", uxr_millis());
    }

    return 0;
}
```

## src/VehicleEmergencyStamped.c
```c
// Copyright 2016 Proyectos y Sistemas de Mantenimiento SL (eProsima).
//
// Licensed under the Apache License, Version 2.0 (the "License");
// you may not use this file except in compliance with the License.
// You may obtain a copy of the License at
//
//     http://www.apache.org/licenses/LICENSE-2.0
//
// Unless required by applicable law or agreed to in writing, software
// distributed under the License is distributed on an "AS IS" BASIS,
// WITHOUT WARRANTIES OR CONDITIONS OF ANY KIND, either express or implied.
// See the License for the specific language governing permissions and
// limitations under the License.

/*!
 * @file VehicleEmergencyStamped.c
 * This source file contains the definition of the described types in the IDL file.
 *
 * This file was generated by the tool gen.
 */

#include "VehicleEmergencyStamped.h"

#include <ucdr/microcdr.h>
#include <string.h>

bool builtin_interfaces_msg_Time_serialize_topic(ucdrBuffer* writer, const builtin_interfaces_msg_Time* topic)
{
    bool success = true;

        success &= ucdr_serialize_int32_t(writer, topic->sec);

        success &= ucdr_serialize_uint32_t(writer, topic->nanosec);

    return success && !writer->error;
}

bool builtin_interfaces_msg_Time_deserialize_topic(ucdrBuffer* reader, builtin_interfaces_msg_Time* topic)
{
    bool success = true;

        success &= ucdr_deserialize_int32_t(reader, &topic->sec);

        success &= ucdr_deserialize_uint32_t(reader, &topic->nanosec);

    return success && !reader->error;
}

uint32_t builtin_interfaces_msg_Time_size_of_topic(const builtin_interfaces_msg_Time* topic, uint32_t size)
{
    uint32_t previousSize = size;
        size += ucdr_alignment(size, 4) + 4;

        size += ucdr_alignment(size, 4) + 4;

    return size - previousSize;
}

bool tier4_vehicle_msgs_msg_VehicleEmergencyStamped_serialize_topic(ucdrBuffer* writer, const tier4_vehicle_msgs_msg_VehicleEmergencyStamped* topic)
{
    bool success = true;

        success &= builtin_interfaces_msg_Time_serialize_topic(writer, &topic->stamp);
        success &= ucdr_serialize_bool(writer, topic->emergency);

    return success && !writer->error;
}

bool tier4_vehicle_msgs_msg_VehicleEmergencyStamped_deserialize_topic(ucdrBuffer* reader, tier4_vehicle_msgs_msg_VehicleEmergencyStamped* topic)
{
    bool success = true;

        success &= builtin_interfaces_msg_Time_deserialize_topic(reader, &topic->stamp);
        success &= ucdr_deserialize_bool(reader, &topic->emergency);

    return success && !reader->error;
}

uint32_t tier4_vehicle_msgs_msg_VehicleEmergencyStamped_size_of_topic(const tier4_vehicle_msgs_msg_VehicleEmergencyStamped* topic, uint32_t size)
{
    uint32_t previousSize = size;
        size += builtin_interfaces_msg_Time_size_of_topic(&topic->stamp, size);
        size += ucdr_alignment(size, 1) + 1;

    return size - previousSize;
}
```

## src/VehicleEmergencyStamped.h
```c
// Copyright 2016 Proyectos y Sistemas de Mantenimiento SL (eProsima).
//
// Licensed under the Apache License, Version 2.0 (the "License");
// you may not use this file except in compliance with the License.
// You may obtain a copy of the License at
//
//     http://www.apache.org/licenses/LICENSE-2.0
//
// Unless required by applicable law or agreed to in writing, software
// distributed under the License is distributed on an "AS IS" BASIS,
// WITHOUT WARRANTIES OR CONDITIONS OF ANY KIND, either express or implied.
// See the License for the specific language governing permissions and
// limitations under the License.

/*!
 * @file VehicleEmergencyStamped.h
 * This header file contains the declaration of the described types in the IDL file.
 *
 * This file was generated by the tool gen.
 */

#ifndef _VehicleEmergencyStamped_H_
#define _VehicleEmergencyStamped_H_

#ifdef __cplusplus
extern "C"
{
#endif

#include <stdint.h>
#include <stdbool.h>

typedef struct builtin_interfaces_msg_Time
{
    int32_t sec;
    uint32_t nanosec;
} builtin_interfaces_msg_Time;

struct ucdrBuffer;

bool builtin_interfaces_msg_Time_serialize_topic(struct ucdrBuffer* writer, const builtin_interfaces_msg_Time* topic);
bool builtin_interfaces_msg_Time_deserialize_topic(struct ucdrBuffer* reader, builtin_interfaces_msg_Time* topic);
uint32_t builtin_interfaces_msg_Time_size_of_topic(const builtin_interfaces_msg_Time* topic, uint32_t size);

typedef struct tier4_vehicle_msgs_msg_VehicleEmergencyStamped
{
    builtin_interfaces_msg_Time stamp;
    bool emergency;
} tier4_vehicle_msgs_msg_VehicleEmergencyStamped;

struct ucdrBuffer;

bool tier4_vehicle_msgs_msg_VehicleEmergencyStamped_serialize_topic(struct ucdrBuffer* writer, const tier4_vehicle_msgs_msg_VehicleEmergencyStamped* topic);
bool tier4_vehicle_msgs_msg_VehicleEmergencyStamped_deserialize_topic(struct ucdrBuffer* reader, tier4_vehicle_msgs_msg_VehicleEmergencyStamped* topic);
uint32_t tier4_vehicle_msgs_msg_VehicleEmergencyStamped_size_of_topic(const tier4_vehicle_msgs_msg_VehicleEmergencyStamped* topic, uint32_t size);


#ifdef __cplusplus
}
#endif

#endif // _VehicleEmergencyStamped_H_
```

## src/brake_feedback_dds.c
```c
#include "brake_feedback_dds.h"
#include "sensor_dds.h"
#include "VehicleEmergencyStamped.h"

#ifdef CONFIG_GPIO_RCAR
#include <zephyr/drivers/led.h>
#include <zephyr/drivers/gpio.h>
#endif

#include "config.h"

#include <stdio.h>

K_EVENT_DEFINE(BRAKE_DDS_SETUP_EVENT)

#ifdef CONFIG_GPIO_RCAR
#define LED0_NODE DT_ALIAS(led0)
#define LED1_NODE DT_ALIAS(led1)
#define LED2_NODE DT_ALIAS(led2)
static const struct led_dt_spec led0 = LED_DT_SPEC_GET(LED0_NODE);
static const struct led_dt_spec led1 = LED_DT_SPEC_GET(LED1_NODE);
static const struct led_dt_spec led2 = LED_DT_SPEC_GET(LED2_NODE);

#define SW0_NODE DT_ALIAS(sw0)
static const struct gpio_dt_spec button0 = GPIO_DT_SPEC_GET(SW0_NODE, gpios);
#endif

enum BRAKE_DDS_EVENTS 
{
    BRAKE_DDS_NO_DDS = 0b01,
    BRAKE_DDS_CONNECTED = 0b10
};

enum SENSOR_DDS_EVENTS 
{
    SENSOR_DDS_NO_DDS = 0b01,
    SENSOR_DDS_CONNECTED = 0b10
};

uint8_t brake_dds_ubOutBuffer[256];
ucdrBuffer brake_dds_ubOut;

uxrSession brake_dds_session;
uxrUDPTransport brake_dds_transport;

uint8_t brake_dds_outbuf[BRAKE_BUFFER_SIZE * BRAKE_STREAM_HISTORY];
uint8_t brake_dds_inbuf[BRAKE_BUFFER_SIZE * BRAKE_STREAM_HISTORY];

uxrObjectId brake_dds_uxrid_entity;
uxrObjectId brake_dds_uxrid_topic;
uxrObjectId brake_dds_uxrid_sub;
uxrObjectId brake_dds_uxrid_pub;
uxrObjectId brake_dds_uxrid_reader;
uxrObjectId brake_dds_uxrid_writer;
uxrObjectId brake_dds_uxrid_participant; 

uxrStreamId brake_dds_out;
uxrStreamId brake_dds_in;

extern bool new_msg;
extern bool sensor_brake_signal;
extern float sensor_mps;

extern uxrSession sensor_dds_session;
extern ucdrBuffer sensor_dds_ubOut;
extern uxrObjectId sensor_dds_uxrid_writer;
extern uxrStreamId sensor_dds_out;

extern struct k_event SENSOR_DDS_SETUP_EVENT;

// K_THREAD_DEFINE(brake_dds_setup_tid, 5000, brake_dds_setup, NULL, NULL, NULL, 5, K_ESSENTIAL, 0);
// K_THREAD_DEFINE(brake_dds_process_tid, 5000, brake_dds_process, NULL, NULL, NULL, 5, K_ESSENTIAL, 0);
// K_THREAD_DEFINE(brake_dds_check_tid, 5000, brake_dds_check, NULL, NULL, NULL, 5, K_ESSENTIAL, 0);

K_MUTEX_DEFINE(BRAKE_DDS_LOCK);

void brake_dds_setup(void *, void *, void *)
{
    while(1)
    {
        k_event_wait(&BRAKE_DDS_SETUP_EVENT, BRAKE_DDS_NO_DDS, false, K_FOREVER);

        printf("Starting Brake DDS transport init\n");

        ucdr_init_buffer(&brake_dds_ubOut, brake_dds_ubOutBuffer, 256);
        ucdr_reset_buffer(&brake_dds_ubOut);

        if (!uxr_init_udp_transport(&brake_dds_transport, UXR_IPv4, BRAKE_FEEDBACK_DDS_IP_ADDR, BRAKE_FEEDBACK_DDS_IP_PORT))
        {
            printf("Attempted Brake DDS transport init ...\n");
            k_sleep(K_SECONDS(5));
            continue;
        } else {
            printf("Finished Brake DDS transport init\n");
        }

        printf("Starting Brake DDS session init\n");
        
        uxr_init_session(&brake_dds_session, &brake_dds_transport.comm, 0xDECAFBAD);

        if (!uxr_create_session(&brake_dds_session))
        {
            printf("Attempted Brake DDS session init ...\n");
            goto remove_session;
        } else {
            printf("Finished Brake DDS session init\n");
        }

        uxr_set_topic_callback(&brake_dds_session, brake_on_msg, NULL);

        if (!uxr_ping_agent_session(&brake_dds_session, 100, 1))
        {
            printf("Brake DDS - Sorry, no agent available\n");
            goto remove_session;
        }

        //Setup subscribers
        brake_dds_out = uxr_create_output_reliable_stream(
            &brake_dds_session, brake_dds_outbuf, BRAKE_BUFFER_SIZE, BRAKE_STREAM_HISTORY);

        brake_dds_in = uxr_create_input_reliable_stream(
            &brake_dds_session, brake_dds_inbuf, BRAKE_BUFFER_SIZE, BRAKE_STREAM_HISTORY);

        brake_dds_uxrid_participant = uxr_object_id(0x01, UXR_PARTICIPANT_ID);
        brake_dds_uxrid_topic  = uxr_object_id(0x01, UXR_TOPIC_ID);
        brake_dds_uxrid_pub    = uxr_object_id(0x01, UXR_PUBLISHER_ID);
        brake_dds_uxrid_writer = uxr_object_id(0x01, UXR_DATAWRITER_ID);
        uint8_t     status[4];
        uint16_t    requests[4] = {
            uxr_buffer_create_participant_xml(&brake_dds_session, brake_dds_out, brake_dds_uxrid_participant, 0,
                "<dds>"
                    "<participant>"
                        "<rtps>"
                            "<name>default_xrce_participant</name>"
                        "</rtps>"
                    "</participant>"
                "</dds>"
                , UXR_REPLACE),
            uxr_buffer_create_topic_xml(&brake_dds_session, brake_dds_out, brake_dds_uxrid_topic, brake_dds_uxrid_participant,
                "<dds>"
                    "<topic>"
                        "<name>rt/control/command/emergency_cmd2</name>"
                        "<dataType>tier4_vehicle_msgs::msg::dds_::VehicleEmergencyStamped_</dataType>"
                    "</topic>"
                "</dds>",
                    UXR_REPLACE),
            uxr_buffer_create_publisher_xml(&brake_dds_session, brake_dds_out, brake_dds_uxrid_pub, brake_dds_uxrid_participant, "", UXR_REPLACE),
            uxr_buffer_create_datawriter_xml(&brake_dds_session, brake_dds_out, brake_dds_uxrid_writer, brake_dds_uxrid_pub,
                "<dds>"
                    "<data_writer>"
                        "<topic>"
                            "<kind>NO_KEY</kind>"
                            "<name>rt/control/command/emergency_cmd2</name>"
                            "<dataType>tier4_vehicle_msgs::msg::dds_::VehicleEmergencyStamped_</dataType>"
                        "</topic>"
                    "</data_writer>"
                "</dds>"
                , UXR_REPLACE)
        };

        if (!uxr_run_session_until_all_status(&brake_dds_session, 100, requests, status, 4)) {
            printf("failed to create entities: participant: %i topic: %i "
                "sub: %i reader: %i\n",
                status[0], status[1], status[2], status[3]);
            goto remove_session;
        }

        printf("Brake DDS Success! Agent is up within a session\n");

        k_event_set(&BRAKE_DDS_SETUP_EVENT, BRAKE_DDS_CONNECTED);
        continue;

    remove_session:
        // Delete resources
        uxr_delete_session(&brake_dds_session);

        uxr_close_udp_transport(&brake_dds_transport);
        
    }
}

void brake_dds_check(void *, void *, void *)
{
    int brake_fail_count = 0;

    while (1)
    {
        k_event_wait(&BRAKE_DDS_SETUP_EVENT, BRAKE_DDS_CONNECTED, false, K_FOREVER);

        k_mutex_lock(&BRAKE_DDS_LOCK, K_FOREVER);
        bool brake_connected = uxr_ping_agent_session(&brake_dds_session, 20, 5);
        k_mutex_unlock(&BRAKE_DDS_LOCK);

        if (!brake_connected)
        {
            brake_fail_count++;

            if (brake_fail_count >= 2)
            {
                k_sched_lock();
                uxr_delete_session(&brake_dds_session);
                uxr_close_udp_transport(&brake_dds_transport);

                k_event_set(&BRAKE_DDS_SETUP_EVENT, BRAKE_DDS_NO_DDS);
                k_sched_unlock();

                printf("Brake Session Disconnected\n");
            }
        } else {
            brake_fail_count = 0;
        }

        k_yield();
    }
}

void brake_dds_process(void *, void *, void *)
{
    bool prev_brake_signal = false;
    bool confirmed_delivery = false;


    while(1)
    {
        
        #ifdef CONFIG_GPIO_RCAR
        bool brake = gpio_pin_get_dt(&button0);
        #else
        bool brake = false;
        #endif

        if (prev_brake_signal && (sensor_mps >= 0.05 || sensor_mps <= -0.05))
            brake = true;

        int64_t time_triggered = uxr_millis();

        bool brake_session_up = k_event_test(&BRAKE_DDS_SETUP_EVENT, BRAKE_DDS_CONNECTED) == BRAKE_DDS_CONNECTED;
        bool sensor_session_up = k_event_test(&SENSOR_DDS_SETUP_EVENT, SENSOR_DDS_CONNECTED) == SENSOR_DDS_CONNECTED;

        if (sensor_session_up)
        {
            brake = sensor_brake_signal || brake;
        }

        #ifdef CONFIG_GPIO_RCAR
        if (brake) {
            led_on_dt(&led0);
            led_on_dt(&led1);
            led_on_dt(&led2);
        } else {
            led_off_dt(&led0);
            led_off_dt(&led1);
            led_off_dt(&led2);
        }
        #endif

        if(new_msg) {
            tier4_vehicle_msgs_msg_VehicleEmergencyStamped topic = {
                {0, 0}, brake
            };

            if (brake_session_up)
            {	
                ucdr_reset_buffer(&brake_dds_ubOut);
                uint32_t topic_size = tier4_vehicle_msgs_msg_VehicleEmergencyStamped_size_of_topic(&topic, 0);
                uxr_prepare_output_stream(&brake_dds_session, brake_dds_out, brake_dds_uxrid_writer, &brake_dds_ubOut, topic_size);
                tier4_vehicle_msgs_msg_VehicleEmergencyStamped_serialize_topic(&brake_dds_ubOut, &topic);
            }

            if (sensor_session_up)
            {
                ucdr_reset_buffer(&sensor_dds_ubOut);

                ucdr_serialize_endian_bool(&sensor_dds_ubOut, UCDR_LITTLE_ENDIANNESS, brake);
                ucdr_serialize_endian_int32_t(&sensor_dds_ubOut, UCDR_LITTLE_ENDIANNESS, time_triggered);

                uxr_prepare_output_stream(&sensor_dds_session, sensor_dds_out, sensor_dds_uxrid_writer, &sensor_dds_ubOut, 8);
            }
            
            if (brake)
            {
                if (brake_session_up)
                {
                    printf("[%07lli] Brake On!\n", time_triggered);
                } else {
                    printf("[%07lli] Brake On!  - No DDS Connection\n", time_triggered);
                }
            }  else {
                if (brake_session_up)
                {
                    printf("[%07lli] Brake Off\n", time_triggered);
                } else {
                    printf("[%07lli] Brake Off  - No DDS Connection\n", time_triggered);
                }
            }

            prev_brake_signal = brake;
            new_msg = false;
        }

        if (brake_session_up || !confirmed_delivery)
        {
            k_mutex_lock(&BRAKE_DDS_LOCK, K_FOREVER);
            confirmed_delivery = uxr_run_session_until_confirm_delivery(&brake_dds_session, 50);
            k_mutex_unlock(&BRAKE_DDS_LOCK);
        }

        k_yield();
    }
}

void brake_on_msg(uxrSession *sess, uxrObjectId obj_id, uint16_t req_id, \
    uxrStreamId stream, struct ucdrBuffer *ub, uint16_t len, void *_)
{
    (void)sess;
	(void)req_id;
	(void)stream;
	(void)_;
	(void)len;

	// printf("on_msg");

	printf("Unexpected Brake DDS msg\n");
}
```

## src/brake_feedback_dds.h
```c
#pragma once

#include <uxr/client/client.h>
#include <ucdr/microcdr.h>

#include <uxr/client/util/ping.h>
#include <uxr/client/util/time.h>

#include <zephyr/kernel.h>

#define BRAKE_STREAM_HISTORY 8
#define BRAKE_BUFFER_SIZE    1024

void brake_dds_setup(void *, void *, void *);
void brake_dds_check(void *, void *, void *);
void brake_dds_process(void *, void *, void *);

void brake_on_msg(uxrSession *sess, uxrObjectId obj_id, uint16_t req_id, 
    uxrStreamId stream, struct ucdrBuffer *ub, uint16_t len, void *_);
```

## src/config.h
```c
#pragma once

//IP and Port for Brake Feedback DDS (Microxrce Bridge to AWSIM)
#define BRAKE_FEEDBACK_DDS_IP_ADDR "192.168.2.2"
#define BRAKE_FEEDBACK_DDS_IP_PORT "2018"

//IP and Port for Sensor DDS (EBS)
#define SENSOR_DDS_IP_ADDR "192.168.2.2"
#define SENSOR_DDS_IP_PORT "2019"
```

## src/sensor_dds.c
```c
#include "sensor_dds.h"
#include <stdio.h>

#include "config.h"

K_EVENT_DEFINE(SENSOR_DDS_SETUP_EVENT)

enum SENSOR_DDS_EVENTS 
{
    SENSOR_DDS_NO_DDS = 0b01,
    SENSOR_DDS_CONNECTED = 0b10
};

bool new_msg = false;
bool sensor_brake_signal = false;
float sensor_mps = 0.0;

uint8_t sensor_dds_ubOutBuffer[256];
uint8_t sensor_dds_outbuf[SENSOR_BUFFER_SIZE * SENSOR_STREAM_HISTORY];
uint8_t sensor_dds_inbuf[SENSOR_BUFFER_SIZE * SENSOR_STREAM_HISTORY];

ucdrBuffer sensor_dds_ubOut;

uxrSession sensor_dds_session;
uxrUDPTransport sensor_dds_transport;

uxrObjectId sensor_dds_uxrid_entity;
uxrObjectId sensor_dds_uxrid_topic;
uxrObjectId sensor_dds_uxrid_sub;
uxrObjectId sensor_dds_uxrid_pub;
uxrObjectId sensor_dds_uxrid_reader;
uxrObjectId sensor_dds_uxrid_writer;

uxrStreamId sensor_dds_out;
uxrStreamId sensor_dds_in;

// K_THREAD_DEFINE(sensor_dds_setup_tid, 5000, sensor_dds_setup, NULL, NULL, NULL, 5, K_ESSENTIAL, 0);
// K_THREAD_DEFINE(sensor_dds_process_tid, 5000, sensor_dds_process, NULL, NULL, NULL, 5, K_ESSENTIAL, 0);

void sensor_dds_setup(void *, void *, void *) 
{
    while(1)
    {
        k_event_wait(&SENSOR_DDS_SETUP_EVENT, SENSOR_DDS_NO_DDS, false, K_FOREVER);

        printf("Starting Sensor DDS transport init\n");

        ucdr_init_buffer(&sensor_dds_ubOut, sensor_dds_ubOutBuffer, 256);
        ucdr_reset_buffer(&sensor_dds_ubOut);

        
        if (!uxr_init_udp_transport(&sensor_dds_transport, UXR_IPv4, SENSOR_DDS_IP_ADDR, SENSOR_DDS_IP_PORT))
        {
            printf("Attempted Sensor DDS transport init ...\n");
            k_sleep(K_SECONDS(5));
            continue;
        } else {
            printf("Finished Sensor DDS transport init\n");
        }

        printf("Starting Sensor DDS session init\n");

        uxr_init_session(&sensor_dds_session, &sensor_dds_transport.comm, 0xDECAFBAD);

        if (!uxr_create_session(&sensor_dds_session))
        {
            printf("Attempted Sensor dds session init ...\n");
            goto remove_session;
        } else {
            printf("Finished Sensor dds session init\n");
        }

        uxr_set_topic_callback(&sensor_dds_session, sensor_on_msg, NULL);

        if (!uxr_ping_agent_session(&sensor_dds_session, 100, 1))
        {
            printf("Sensor DDS Sorry, no agent available\n");
            goto remove_session;
        }

        //Setup subscribers
        sensor_dds_out = uxr_create_output_reliable_stream( \
            &sensor_dds_session, sensor_dds_outbuf, SENSOR_BUFFER_SIZE, SENSOR_STREAM_HISTORY);

        sensor_dds_in = uxr_create_input_reliable_stream( \
            &sensor_dds_session, sensor_dds_inbuf, SENSOR_BUFFER_SIZE, SENSOR_STREAM_HISTORY);

        sensor_dds_uxrid_entity = uxr_object_id(0x01, UXR_PARTICIPANT_ID);
        sensor_dds_uxrid_topic  = uxr_object_id(0x01, UXR_TOPIC_ID);
        sensor_dds_uxrid_sub    = uxr_object_id(0x01, UXR_SUBSCRIBER_ID);
        sensor_dds_uxrid_pub    = uxr_object_id(0x01, UXR_PUBLISHER_ID);
        sensor_dds_uxrid_reader = uxr_object_id(0x01, UXR_DATAREADER_ID);
        sensor_dds_uxrid_writer = uxr_object_id(0x01, UXR_DATAWRITER_ID);
        uint8_t     status[6];
        uint16_t    requests[6] = {
            uxr_buffer_create_participant_xml(
                    &sensor_dds_session, sensor_dds_out, sensor_dds_uxrid_entity, 0, //
                    "	<dds>"
                    "		<participant>"
                    "			<rtps>"
                    "				<name>subscriber</name>"
                    "			</rtps>"
                    "		</participant>"
                    "	</dds>",
                    UXR_REPLACE),
            uxr_buffer_create_topic_xml(&sensor_dds_session, sensor_dds_out, sensor_dds_uxrid_topic, sensor_dds_uxrid_entity, 
                    "	<dds>"
                    "		<topic>"
                    "			<name>messages_in</name>"
                    "			<dataType>inputMsg</dataType>"
                    "		</topic>"
                    "		<topic>"
                    "			<name>messages_out</name>"
                    "			<dataType>outputMsg</dataType>"
                    "		</topic>"
                    "	</dds>",
                    UXR_REPLACE),
            uxr_buffer_create_subscriber_xml(&sensor_dds_session, sensor_dds_out, sensor_dds_uxrid_sub, sensor_dds_uxrid_entity, "", UXR_REPLACE),
            uxr_buffer_create_publisher_xml(&sensor_dds_session, sensor_dds_out, sensor_dds_uxrid_pub, sensor_dds_uxrid_entity, "", UXR_REPLACE),
            uxr_buffer_create_datareader_xml(
                    &sensor_dds_session, sensor_dds_in, sensor_dds_uxrid_reader, sensor_dds_uxrid_sub, 
                "	<dds>"
                "		<data_reader>"
                "			<topic>"
                "				<kind>NO_KEY</kind>"
                "				<name>messages_in</name>"
                "				<dataType>inputMsg</dataType>"
                "			</topic>"
                "		</data_reader>"
                "	</dds>",
                    UXR_REPLACE),
            uxr_buffer_create_datawriter_xml(
                &sensor_dds_session, sensor_dds_out, sensor_dds_uxrid_writer, sensor_dds_uxrid_pub, //
                "	<dds>"
                "		<data_writer>"
                "			<topic>"
                "				<kind>NO_KEY</kind>"
                "				<name>messages_out</name>"
                "				<dataType>outputMsg</dataType>"
                "			</topic>"
                "		</data_writer>"
                "	</dds>",
                UXR_REPLACE),
            };

        if (!uxr_run_session_until_all_status(&sensor_dds_session, 100, requests, status, 6)) {
            printf("failed to create entities: participant: %i topic: %i "
                "sub: %i reader: %i\n",
                status[0], status[1], status[2], status[3]);
            goto remove_session;
        }

        uxrDeliveryControl delivery_control = {0};
        delivery_control.max_samples        = UXR_MAX_SAMPLES_UNLIMITED;
        uxr_buffer_request_data(&sensor_dds_session, sensor_dds_out, sensor_dds_uxrid_reader, sensor_dds_in, &delivery_control);
        
        printf("Sensor DDS Success! Agent is up within a session\n");

        k_event_set(&SENSOR_DDS_SETUP_EVENT, SENSOR_DDS_CONNECTED);
        continue;

    remove_session:
        // Delete resources
        uxr_delete_session(&sensor_dds_session);

        uxr_close_udp_transport(&sensor_dds_transport);

        k_yield();
    }
}

void sensor_dds_process(void *, void *, void *) 
{
    int sensor_dds_fail_count = 0;

    while(1)
    {
        k_event_wait(&SENSOR_DDS_SETUP_EVENT, SENSOR_DDS_CONNECTED, false, K_FOREVER);

        bool sensor_dds_connected = uxr_ping_agent_session(&sensor_dds_session, 20, 5);

        if (!sensor_dds_connected)
        {
            sensor_dds_fail_count++;

            if (sensor_dds_fail_count >= 2)
            {
                k_sched_lock();
                uxr_delete_session(&sensor_dds_session);
                uxr_close_udp_transport(&sensor_dds_transport);

                k_event_set(&SENSOR_DDS_SETUP_EVENT, SENSOR_DDS_NO_DDS);

                k_sched_unlock();

                printf("Sensor Session Disconnected\n");
            }
        } else {
            sensor_dds_fail_count = 0;
        }

        k_yield();
    }
}

void sensor_on_msg(uxrSession *sess, uxrObjectId obj_id, uint16_t req_id, \
    uxrStreamId stream, struct ucdrBuffer *ub, uint16_t len, void *_)
{
    (void)sess;
	(void)req_id;
	(void)stream;
	(void)_;
	(void)len;

	// printf("on_msg");

	if (obj_id.type == UXR_DATAREADER_ID && obj_id.id == 0x1)
	{
		bool brake_apply;
        float mps;
		ucdr_deserialize_endian_bool(ub, UCDR_LITTLE_ENDIANNESS, &brake_apply);
		ucdr_deserialize_endian_float(ub, UCDR_LITTLE_ENDIANNESS, &mps);

		// printf("on_msg %d", brake_apply);

		sensor_brake_signal = brake_apply;
        sensor_mps = mps;
        new_msg = true;
        printf("Recv'd DDS Message. Signal: %x, MPS: %f\n", brake_apply, mps);
	}
}
```

## src/sensor_dds.h
```c
#pragma once

#include <uxr/client/client.h>
#include <ucdr/microcdr.h>

#include <uxr/client/util/ping.h>
#include <uxr/client/util/time.h>

#include <zephyr/kernel.h>

#define SENSOR_STREAM_HISTORY 8
#define SENSOR_BUFFER_SIZE    1024

void sensor_dds_setup(void *, void *, void *);
void sensor_dds_process(void *, void *, void *);

void sensor_on_msg(uxrSession *sess, uxrObjectId obj_id, uint16_t req_id, 
    uxrStreamId stream, struct ucdrBuffer *ub, uint16_t len, void *_);
```
