## CMakeLists.txt
```
# SPDX-FileCopyrightText: <text>Copyright 2023 Arm Limited and/or its
# affiliates <open-source-office@arm.com></text>
#
# SPDX-License-Identifier: Apache-2.0

cmake_minimum_required(VERSION 3.23.0)

set(CONF_FILE "prj.conf")

find_package(Zephyr REQUIRED HINTS $ENV{ZEPHYR_BASE})

project(psa_crypto_tests)

target_sources(app PRIVATE src/main.c)
```

## prj.conf
```kconfig
# SPDX-FileCopyrightText: <text>Copyright 2023 Arm Limited and/or its
# affiliates <open-source-office@arm.com></text>
#
# SPDX-License-Identifier: Apache-2.0

#
# mbedtls
#
CONFIG_MBEDTLS=y
CONFIG_MBEDTLS_BUILTIN=y

#
# PSA service
#
CONFIG_PSA=y

#
# Supported TLS version
#
CONFIG_MBEDTLS_TLS_VERSION_1_2=y
# end of Supported TLS version


#
# Supported key exchange modes
#
CONFIG_MBEDTLS_KEY_EXCHANGE_ALL_ENABLED=y
CONFIG_MBEDTLS_ECDSA_DETERMINISTIC=y
# end of Supported key exchange modes

#
# Elliptic curve libraries
#
CONFIG_MBEDTLS_ECDH_C=y
CONFIG_MBEDTLS_ECDSA_C=y
CONFIG_MBEDTLS_ECJPAKE_C=y
CONFIG_MBEDTLS_ECP_C=y

#
# Supported elliptic curves
#
CONFIG_MBEDTLS_ECP_ALL_ENABLED=y
# end of Supported elliptic curves

#
# Supported hash
#
CONFIG_MBEDTLS_HASH_ALL_ENABLED=y
# end of Supported hash

#
# Supported cipher modes
#
CONFIG_MBEDTLS_CIPHER_ALL_ENABLED=y
# end of Supported cipher modes

#
# Supported message authentication methods
#
CONFIG_MBEDTLS_MAC_ALL_ENABLED=y
# end of Ciphersuite configuration

#
# Random number generators
#
CONFIG_MBEDTLS_CTR_DRBG_ENABLED=y
CONFIG_MBEDTLS_HMAC_DRBG_ENABLED=y
CONFIG_TEST_RANDOM_GENERATOR=y
# end of Random Number Generators

#
# Other configurations
#
CONFIG_MBEDTLS_ENABLE_HEAP=y
CONFIG_MBEDTLS_HEAP_SIZE=65536
CONFIG_MAIN_STACK_SIZE=1048576
CONFIG_MBEDTLS_ENTROPY_ENABLED=y
CONFIG_MBEDTLS_PK_WRITE_C=y
CONFIG_MBEDTLS_PKCS5_C=y
CONFIG_MBEDTLS_PSA_CRYPTO_C=y

CONFIG_MBEDTLS_ZEPHYR_ENTROPY=y
CONFIG_APP_LINK_WITH_MBEDTLS=y

CONFIG_PSA_ARCH_TEST_CRYPTO=y
CONFIG_PSA_ARCH_TEST_API_MBEDTLS_HEADERS=y
# end of mbedtls
```

## src/main.c
```c
/*
 * SPDX-FileCopyrightText: <text>Copyright 2023 Arm Limited and/or its
 * affiliates <open-source-office@arm.com></text>
 *
 * SPDX-License-Identifier: Apache-2.0
 */

#include <zephyr/kernel.h>

/* Run the PSA test suite */
void psa_test(void);

int main(void)
{
#ifdef CONFIG_PSA_ARCH_TEST_NONE
	#error "No PSA test suite set. Use Kconfig to enable a test suite.\n"
#else
	psa_test();
#endif

	return 0;
}
```
